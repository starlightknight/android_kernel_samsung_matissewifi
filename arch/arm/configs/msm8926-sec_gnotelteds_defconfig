## arch/arm/configs/msm8926-sec_gnotelteds_defconfig
```kconfig
#variant defconfig
CONFIG_MACH_GNOTELTEDS_OPEN=y
CONFIG_SEC_GNOTELTEDS_COMMON=y
CONFIG_SEC_GNOTE_PROJECT=y

#Power Management
CONFIG_SEC_PM=n

#LCD
CONFIG_FB_MSM_MIPI_S6E88A0_QHD_VIDEO_PT_PANEL=y
#CONFIG_ESD_ERR_FG_RECOVERY is not set
CONFIG_FB_MSM_MDSS=y
CONFIG_FB_MSM_MDSS_WRITEBACK=y
CONFIG_BACKLIGHT_LCD_SUPPORT=y
#CONFIG_MDNIE_LITE_TUNING is not set
CONFIG_LCD_CLASS_DEVICE=y
CONFIG_BACKLIGHT_CLASS_DEVICE=y
#CONFIG_BACKLIGHT_GENERIC is not set

#VIBRATOR
#CONFIG_QPNP_VIBRATOR is not set
#CONFIG_MSM_VIBRATOR is not set
#CONFIG_VIBETONZ is not set
#CONFIG_MOTOR_DRV_DRV2603 is not set

#TSP
#CONFIG_TOUCHSCREEN_MMS252 is not set
#CONFIG_TOUCHSCREEN_BCMTCH15XXX is not set
#CONFIG_KEYBOARD_CYPRESS_TOUCH is not set
#CONFIG_KEYBOARD_CYPRESS_TOUCHKEY_C is not set
#CONFIG_TOUCHSCREEN_CYTTSP5 is not set
#CONFIG_TOUCHSCREEN_CYTTSP5_DEVICETREE_SUPPORT is not set

#SENSOR
#CONFIG_SENSORS is not set
#CONFIG_SENSORS_AK09911C is not set
#CONFIG_INPUT_MPU6500 is not set
#CONFIG_INPUT_MPU6500_SELFTEST is not set
#CONFIG_INPUT_MPU6500_POLLING is not set
#CONFIG_SENSORS_GP2A030A is not set
#CONFIG_SENSORS_GP2A030A_PROX is not set

CONFIG_INPUT_POLLDEV=y
CONFIG_INPUT=y
CONFIG_INPUT_GPIO=y
CONFIG_SENSORS_HALL=y

#CAMERA
#CONFIG_MSM_CPP  is not set
#CONFIG_S5K4H5YB is not set
#CONFIG_S5K8B1YX is not set

#USB
CONFIG_USB_ANDROID_SAMSUNG_COMPOSITE=y
CONFIG_USB_ANDROID_SAMSUNG_MTP=y
CONFIG_USB_DUN_SUPPORT=y
CONFIG_USB_HOST_NOTIFY=y
CONFIG_USB_STORAGE_DETECT=y
CONFIG_USB_ANDROID_SAMSUNG_SIDESYNC=y

#MUIC
#CONFIG_MFD_MAX77693=y
#CONFIG_USB_SWITCH_MAX77693=y
#CONFIG_REGULATOR_MAX77693=y
#CONFIG_DI_MUIC=n
#CONFIG_MUIC_INIT_DETECT_DELAY=3000
#CONFIG_MUIC_USB_DETECT_DELAY=17000
CONFIG_USB_SWITCH_TSU6721=y

# IRDA support
# CONFIG_IR_REMOCON_MC96 is not set

#Battery charging & BMS
CONFIG_QPNP_SEC_CHARGER=y
CONFIG_BATTERY_BCL=y
CONFIG_QPNP_BMS=y

#BT
no need

#Sec Thermistor
CONFIG_SEC_THERMISTOR=y

#Wifi
no need

# Earjack
CONFIG_SAMSUNG_JACK=y

# CODEC
#CONFIG_SND_SOC_MAX98504 is not set

# GPIO DVS
#CONFIG_SEC_GPIO_DVS is not set
# DHA Solution
#CONFIG_SEC_DHA_SOL_MAL is not set

# NFC
#CONFIG_NFC_DEVICES is not set
#CONFIG_SEC_NFC is not set
#CONFIG_SEC_NFC_IF_I2C is not set
#CONFIG_SEC_NFC_PRODUCT_N5 is not set
#CONFIG_SEC_NFC_CLK_REQ is not set
#CONFIG_SEC_NFC_USE_8226_RFCLK2 is not set
```
